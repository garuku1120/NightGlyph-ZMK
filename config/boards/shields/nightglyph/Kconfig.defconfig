## config/boards/shields/nightglyph/Kconfig.defconfig
```kconfig
if SHIELD_NIGHTGLYPH_LEFT || SHIELD_NIGHTGLYPH_RIGHT

config ZMK_KEYBOARD_NAME
    default "NightGlyph"

config ZMK_SPLIT
    default y

endif

if SHIELD_NIGHTGLYPH_LEFT

config ZMK_SPLIT_ROLE_CENTRAL
    default y

endif
```

## config/boards/shields/nightglyph/Kconfig.shield
```kconfig
config SHIELD_NIGHTGLYPH_LEFT
    def_bool $(shields_list_contains,nightglyph_left)

config SHIELD_NIGHTGLYPH_RIGHT
    def_bool $(shields_list_contains,nightglyph_right)
```
